## components/graphite/Kconfig
```kconfig
menu "Graphite"

config GRAPHITE_ADDR
    string "IPv4 address of Graphite server"

config GRAPHITE_PORT
    int "Port of Graphite server"
    default 2003
endmenu
```

## components/syslog/Kconfig
```kconfig
menu "Syslog"

config SYSLOG_FACILITY
    int "Syslog facility"
    default 16
    help
        List of available Facilities as per RFC5424:
            Numerical             Facility
             Code
              0             kernel messages
              1             user-level messages
              2             mail system
              3             system daemons
              4             security/authorization messages
              5             messages generated internally by syslogd
              6             line printer subsystem
              7             network news subsystem
              8             UUCP subsystem
              9             clock daemon
             10             security/authorization messages
             11             FTP daemon
             12             NTP subsystem
             13             log audit
             14             log alert
             15             clock daemon (note 2)
             16             local use 0  (local0)
             17             local use 1  (local1)
             18             local use 2  (local2)
             19             local use 3  (local3)
             20             local use 4  (local4)
             21             local use 5  (local5)
             22             local use 6  (local6)
             23             local use 7  (local7)


config SYSLOG_ADDR
    string "IPv4 address of syslog server"
    help
        IPv4 address of syslog server. DNS lookups are not supported.

config SYSLOG_PORT
    int "Syslog server port"
    default 514
endmenu
```

## components/wifi/Kconfig
```kconfig
menu "WiFi credentials"

config SSID
    string "Service Set Identifier (SSID)"
    help
      SSID of target AP.

config PASSWORD
    string "Password"
    help
      Password of target AP

config OTA_BASE
    string "ota.home.arpa/ota/"
    help
      Prefix to OTA server. It is used to construct OTA URLs as http://<base><MAC>/<project_name>.version and http://<base><MAC>/<project_name>.bin

      OTA code in firmware will try to fetch the version URL first and compare it to the local version. If content differs,
      the upgrade will start.

      To figure out current version run `make | grep ^App`
endmenu
```
